## build/conf/bblayers.conf
```bitbake
# LAYER_CONF_VERSION is increased each time build/conf/bblayers.conf
# changes incompatibly
LCONF_VERSION = "7"

BBPATH = "${TOPDIR}"
BBFILES ?= ""
BBLAYERS ?= " \
  ${TOPDIR}/repos/openembedded-core/meta \
  ${TOPDIR}/repos/meta-openembedded/meta-xfce \
  ${TOPDIR}/repos/meta-openembedded/meta-oe \
  ${TOPDIR}/repos/meta-openembedded/meta-gnome \
  ${TOPDIR}/repos/meta-openembedded/meta-networking \
  ${TOPDIR}/repos/meta-openembedded/meta-python \
  ${TOPDIR}/repos/meta-virtualization \
  ${TOPDIR}/repos/meta-java \
  ${TOPDIR}/repos/meta-selinux \
  ${TOPDIR}/repos/meta-intel \
  "
```
